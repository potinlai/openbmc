## meta-facebook/meta-yosemite5/meta-yosemite5-ast2700/conf/layer.conf
```bitbake
# We have a conf and classes directory, add to BBPATH
BBPATH .= ":${LAYERDIR}"

# We have recipes-* directories, add to BBFILES
BBFILES += "${LAYERDIR}/recipes-*/*/*.bb \
            ${LAYERDIR}/recipes-*/*/*.bbappend"

BBFILE_COLLECTIONS += "yosemite5-ast2700-layer"
BBFILE_PATTERN_yosemite5-ast2700-layer := "^${LAYERDIR}/"

LAYERSERIES_COMPAT_yosemite5-ast2700-layer := "whinlatter walnascar"
```

## meta-facebook/meta-yosemite5/meta-yosemite5-ast2700/conf/machine/yosemite5-ast2700.conf
```bitbake
# yosemite5-ast2700 config file.

require conf/machine/include/ast2700.inc

require conf/distro/include/phosphor-static-norootfs.inc
require conf/distro/include/pldm.inc
require conf/machine/include/facebook-compute-singlehost.inc
require conf/machine/include/obmc-bsp-common.inc
require conf/machine/include/tpm2.inc
require conf/machine/include/facebook-ncsi-nic.inc

FLASH_SIZE = "131072"

VIRTUAL-RUNTIME_obmc-host-state-manager = "phosphor-state-manager-host"
VIRTUAL-RUNTIME_obmc-chassis-state-manager = "phosphor-state-manager-chassis"

# Note: Yosemite5 does not actually contain two chassis. Currently,
# we use an additional "chassis" to enable the required functionality.
# 0 -> chassis, 1 -> tray
OBMC_CHASSIS_INSTANCES = "0 1"

KERNEL_IMAGETYPE:df-obmc-static-norootfs = "Image"
KERNEL_IMAGETYPES:df-obmc-static-norootfs = "${KERNEL_IMAGETYPE}"
FLASH_KERNEL_IMAGE:df-obmc-static-norootfs = "Image"
FIT_KERNEL_COMP_ALG:df-obmc-static-norootfs ?= "gzip"
FIT_KERNEL_COMP_ALG_EXTENSION:df-obmc-static-norootfs ?= ".gz"

IMAGE_FSTYPES:remove = "mtd-static"
IMAGE_FSTYPES:remove = "mtd-static-alltar"
IMAGE_FSTYPES:remove = "mtd-static-tar"

# Kernel Build Settings
#KERNEL_DEVICETREE = "aspeed/aspeed-bmc-facebook-yosemite5-ast2700.dtb"
KERNEL_DEVICETREE = "aspeed/ast2700-evb.dtb"
KBUILD_DEFCONFIG = "aspeed_g7_defconfig"

# CALIPTRA Settings
CALIPTRA_FW_BINARY = "ast2700-caliptra-fw.bin"

# BootMCU Build Settings
BOOTMCU_MACHINE = "ibex-ast2700_defconfig"
BOOTMCU_FW_BINARY = "ast2700-ibex-spl.bin"

# U-Boot Build Settings
UBOOT_MACHINE = "evb-ast2700_defconfig"
UBOOT_DEVICETREE = "ast2700-evb"
UBOOT_FITIMAGE_ENABLE = "1"

SERIAL_CONSOLES = "57600;ttyS4"

OBMC_COMPATIBLE_NAMES = "com.meta.Hardware.BMC.Model.Yosemite5"

# AST2700 EVB has 128MB SPI flash
FLASH_CALIPTRA_OFFSET:flash-131072 = "0"
FLASH_CALIPTRA_SIZE:flash-131072 = "128"
FLASH_BOOTMCU_OFFSET:flash-131072 = "128"
FLASH_BOOTMCU_SIZE:flash-131072 = "896"
FLASH_UBOOT_OFFSET:flash-131072 = "0"
FLASH_MANIFEST_OFFSET:flash-131072 = "4088"
FLASH_UBOOT_ENV_OFFSET:flash-131072 = "4096"
FLASH_KERNEL_OFFSET:flash-131072 = "4224"
FLASH_ROFS_OFFSET:flash-131072 = "13440"
FLASH_RWFS_OFFSET:flash-131072 = "98304"
```
